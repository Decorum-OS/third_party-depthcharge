## src/board/Kconfig
```kconfig
##
## Copyright 2013 Google Inc.  All rights reserved.
##
## This program is free software; you can redistribute it and/or modify
## it under the terms of the GNU General Public License as published by
## the Free Software Foundation; version 2 of the License.
##
## This program is distributed in the hope that it will be useful,
## but WITHOUT ANY WARRANTY; without even the implied warranty of
## MERCHANTABILITY or FITNESS FOR A PARTICULAR PURPOSE.  See the
## GNU General Public License for more details.
##
## You should have received a copy of the GNU General Public License
## along with this program; if not, write to the Free Software
## Foundation, Inc., 51 Franklin St, Fifth Floor, Boston, MA 02110-1301 USA

menu "Board"

config BOARD
	string "Board name"

config BOARD_DIR
	string "Board directory"
	default BOARD

if BOARD_DIR = "auron"
source src/board/auron/Kconfig
endif
if BOARD_DIR = "bayleybay"
source src/board/bayleybay/Kconfig
endif
if BOARD_DIR = "bolt"
source src/board/bolt/Kconfig
endif
if BOARD_DIR = "daisy"
source src/board/daisy/Kconfig
endif
if BOARD_DIR = "falco"
source src/board/falco/Kconfig
endif
if BOARD_DIR = "foster"
source src/board/foster/Kconfig
endif
if BOARD_DIR = "gizmo"
source src/board/gizmo/Kconfig
endif
if BOARD_DIR = "glados"
source src/board/glados/Kconfig
endif
if BOARD_DIR = "jecht"
source src/board/jecht/Kconfig
endif
if BOARD_DIR = "link"
source src/board/link/Kconfig
endif
if BOARD_DIR = "nyan"
source src/board/nyan/Kconfig
endif
if BOARD_DIR = "nyan_big"
source src/board/nyan_big/Kconfig
endif
if BOARD_DIR = "nyan_blaze"
source src/board/nyan_blaze/Kconfig
endif
if BOARD_DIR = "panther"
source src/board/panther/Kconfig
endif
if BOARD_DIR = "peach_pit"
source src/board/peach_pit/Kconfig
endif
if BOARD_DIR = "peppy"
source src/board/peppy/Kconfig
endif
if BOARD_DIR = "qemu-x86"
source src/board/qemu-x86/Kconfig
endif
if BOARD_DIR = "rambi"
source src/board/rambi/Kconfig
endif
if BOARD_DIR = "rush"
source src/board/rush/Kconfig
endif
if BOARD_DIR = "rush_ryu"
source src/board/rush_ryu/Kconfig
endif
if BOARD_DIR = "samus"
source src/board/samus/Kconfig
endif
if BOARD_DIR = "slippy"
source src/board/slippy/Kconfig
endif
if BOARD_DIR = "smaug"
source src/board/smaug/Kconfig
endif
if BOARD_DIR = "strago"
source src/board/strago/Kconfig
endif
if BOARD_DIR = "veyron_jerry"
source src/board/veyron_jerry/Kconfig
endif
if BOARD_DIR = "veyron_mighty"
source src/board/veyron_mighty/Kconfig
endif
if BOARD_DIR = "veyron_pinky"
source src/board/veyron_pinky/Kconfig
endif
if BOARD_DIR = "veyron_rialto"
source src/board/veyron_rialto/Kconfig
endif
if BOARD_DIR = "veyron_shark"
source src/board/veyron_shark/Kconfig
endif
if BOARD_DIR = "veyron_speedy"
source src/board/veyron_speedy/Kconfig
endif
endmenu
```

## src/drivers/board/Kconfig
```kconfig
##
## Copyright 2013 Google Inc.  All rights reserved.
##
## This program is free software; you can redistribute it and/or modify
## it under the terms of the GNU General Public License as published by
## the Free Software Foundation; version 2 of the License.
##
## This program is distributed in the hope that it will be useful,
## but WITHOUT ANY WARRANTY; without even the implied warranty of
## MERCHANTABILITY or FITNESS FOR A PARTICULAR PURPOSE.  See the
## GNU General Public License for more details.
##
## You should have received a copy of the GNU General Public License
## along with this program; if not, write to the Free Software
## Foundation, Inc., 51 Franklin St, Fifth Floor, Boston, MA 02110-1301 USA

menu "Board"

config BOARD
	string "Board name"

config BOARD_DIR
	string "Board directory"
	default BOARD

if BOARD_DIR = "auron"
source src/drivers/board/auron/Kconfig
endif
if BOARD_DIR = "bayleybay"
source src/drivers/board/bayleybay/Kconfig
endif
if BOARD_DIR = "bolt"
source src/drivers/board/bolt/Kconfig
endif
if BOARD_DIR = "daisy"
source src/drivers/board/daisy/Kconfig
endif
if BOARD_DIR = "falco"
source src/drivers/board/falco/Kconfig
endif
if BOARD_DIR = "foster"
source src/drivers/board/foster/Kconfig
endif
if BOARD_DIR = "gizmo"
source src/drivers/board/gizmo/Kconfig
endif
if BOARD_DIR = "glados"
source src/drivers/board/glados/Kconfig
endif
if BOARD_DIR = "jecht"
source src/drivers/board/jecht/Kconfig
endif
if BOARD_DIR = "link"
source src/drivers/board/link/Kconfig
endif
if BOARD_DIR = "nyan"
source src/drivers/board/nyan/Kconfig
endif
if BOARD_DIR = "nyan_big"
source src/drivers/board/nyan_big/Kconfig
endif
if BOARD_DIR = "nyan_blaze"
source src/drivers/board/nyan_blaze/Kconfig
endif
if BOARD_DIR = "panther"
source src/drivers/board/panther/Kconfig
endif
if BOARD_DIR = "peach_pit"
source src/drivers/board/peach_pit/Kconfig
endif
if BOARD_DIR = "peppy"
source src/drivers/board/peppy/Kconfig
endif
if BOARD_DIR = "qemu-x86"
source src/drivers/board/qemu-x86/Kconfig
endif
if BOARD_DIR = "rambi"
source src/drivers/board/rambi/Kconfig
endif
if BOARD_DIR = "rush"
source src/drivers/board/rush/Kconfig
endif
if BOARD_DIR = "rush_ryu"
source src/drivers/board/rush_ryu/Kconfig
endif
if BOARD_DIR = "samus"
source src/drivers/board/samus/Kconfig
endif
if BOARD_DIR = "slippy"
source src/drivers/board/slippy/Kconfig
endif
if BOARD_DIR = "smaug"
source src/drivers/board/smaug/Kconfig
endif
if BOARD_DIR = "strago"
source src/drivers/board/strago/Kconfig
endif
if BOARD_DIR = "uefi"
source src/drivers/board/uefi/Kconfig
endif
if BOARD_DIR = "veyron_jerry"
source src/drivers/board/veyron_jerry/Kconfig
endif
if BOARD_DIR = "veyron_mighty"
source src/drivers/board/veyron_mighty/Kconfig
endif
if BOARD_DIR = "veyron_pinky"
source src/drivers/board/veyron_pinky/Kconfig
endif
if BOARD_DIR = "veyron_rialto"
source src/drivers/board/veyron_rialto/Kconfig
endif
if BOARD_DIR = "veyron_shark"
source src/drivers/board/veyron_shark/Kconfig
endif
if BOARD_DIR = "veyron_speedy"
source src/drivers/board/veyron_speedy/Kconfig
endif
endmenu
```

## src/drivers/layout/Kconfig
```kconfig
##
## Copyright 2016 Google Inc.  All rights reserved.
##
## This program is free software; you can redistribute it and/or modify
## it under the terms of the GNU General Public License as published by
## the Free Software Foundation; version 2 of the License.
##
## This program is distributed in the hope that it will be useful,
## but WITHOUT ANY WARRANTY; without even the implied warranty of
## MERCHANTABILITY or FITNESS FOR A PARTICULAR PURPOSE.  See the
## GNU General Public License for more details.
##
## You should have received a copy of the GNU General Public License
## along with this program; if not, write to the Free Software
## Foundation, Inc., 51 Franklin St, Fifth Floor, Boston, MA 02110-1301 USA

choice
	prompt "Layout driver"
	default DRIVER_LAYOUT_NONE

config DRIVER_LAYOUT_NONE
	bool "No layout driver"

config DRIVER_LAYOUT_COREBOOT
	bool "Find firmware components based on a coreboot layout"
	select DRIVER_STORAGE_FMAP
	select DRIVER_STORAGE_SECTION_INDEX

config DRIVER_LAYOUT_DCDIR
	bool "Find firmware components based on a standard dcdir layout"
	select DRIVER_STORAGE_DCDIR

endchoice
```

## src/drivers/serial/Kconfig
```kconfig
##
## Copyright 2015 Google Inc.  All rights reserved.
##
## This program is free software; you can redistribute it and/or modify
## it under the terms of the GNU General Public License as published by
## the Free Software Foundation; version 2 of the License.
##
## This program is distributed in the hope that it will be useful,
## but WITHOUT ANY WARRANTY; without even the implied warranty of
## MERCHANTABILITY or FITNESS FOR A PARTICULAR PURPOSE.  See the
## GNU General Public License for more details.
##
## You should have received a copy of the GNU General Public License
## along with this program; if not, write to the Free Software
## Foundation, Inc., 51 Franklin St, Fifth Floor, Boston, MA 02110-1301 USA

config DRIVER_SERIAL_8250
	bool "8250, 16450, 16550, 16550A compatible serial port driver"
	default y if ARCH_X86
	default n if !ARCH_X86

config DRIVER_SERIAL_S5P
	bool "Exynos SOC, S5P compatible serial port driver"
	default n

config DRIVER_SERIAL_8250_MMIO32
	bool "Memory-mapped 8250-compatible serial port driver with 32-bit regs"
	default n
```

## src/drivers/storage/Kconfig
```kconfig
##
## Copyright 2016 Google Inc.  All rights reserved.
##
## This program is free software; you can redistribute it and/or modify
## it under the terms of the GNU General Public License as published by
## the Free Software Foundation; version 2 of the License.
##
## This program is distributed in the hope that it will be useful,
## but WITHOUT ANY WARRANTY; without even the implied warranty of
## MERCHANTABILITY or FITNESS FOR A PARTICULAR PURPOSE.  See the
## GNU General Public License for more details.
##
## You should have received a copy of the GNU General Public License
## along with this program; if not, write to the Free Software
## Foundation, Inc., 51 Franklin St, Fifth Floor, Boston, MA 02110-1301 USA

config DRIVER_STORAGE_DCDIR
	bool "Depthcharge directory storage driver"
	default n

config DRIVER_STORAGE_FLASH
	bool "Storage driver which is backed by flash media"
	default n

config DRIVER_STORAGE_FMAP
	bool "Storage driver which is relative to a particular FMAP area"
	default n

config DRIVER_STORAGE_MEMORY
	bool "Memory backed storage"
	default n

config DRIVER_STORAGE_SECTION_INDEX
	bool "Storage driver which is relative to an entry in a section index"
	default n
```

## src/drivers/timer/Kconfig
```kconfig
##
## Copyright 2013 Google Inc.  All rights reserved.
##
## This program is free software; you can redistribute it and/or modify
## it under the terms of the GNU General Public License as published by
## the Free Software Foundation; version 2 of the License.
##
## This program is distributed in the hope that it will be useful,
## but WITHOUT ANY WARRANTY; without even the implied warranty of
## MERCHANTABILITY or FITNESS FOR A PARTICULAR PURPOSE.  See the
## GNU General Public License for more details.
##
## You should have received a copy of the GNU General Public License
## along with this program; if not, write to the Free Software
## Foundation, Inc., 51 Franklin St, Fifth Floor, Boston, MA 02110-1301 USA

config DRIVER_TIMER_DUMMY
	bool "Dummy timer driver"
	default n


config DRIVER_TIMER_RDTSC
	bool "X86's TSC based timer"
	default n
	depends on ARCH_X86


config DRIVER_TIMER_MCT
	bool "Exynos MCT (multi-core timer) driver"
	default n

config DRIVER_TIMER_MCT_HZ
	int "Exynos MCT frequency"
	depends on DRIVER_TIMER_MCT
	default 24000000

config DRIVER_TIMER_MCT_ADDRESS
	hex "Exynos MCT base address"
	depends on DRIVER_TIMER_MCT
	default 0x101c0000


config DRIVER_TIMER_TEGRA_1US
	bool "Tegra 1us timer driver"
	default n

config DRIVER_TIMER_TEGRA_1US_ADDRESS
	hex "Tegra 1us timer base address"
	depends on DRIVER_TIMER_TEGRA_1US
	default 0x60005010


config DRIVER_TIMER_ROCKCHIP
	bool "Rockchip timer driver"
	default n

config DRIVER_TIMER_ROCKCHIP_ADDRESS
	hex "Rockchip timer base address"
	depends on DRIVER_TIMER_ROCKCHIP
	default 0xff810020


config DRIVER_TIMER_MEDIATEK
	bool "MediaTek MT8173 timer driver"
	default n

config DRIVER_TIMER_MEDIATEK_HZ
	int "MediaTek general purpose timer frequency"
	depends on DRIVER_TIMER_MEDIATEK
	default 13000000

config DRIVER_TIMER_MEDIATEK_ADDRESS
	hex "MTK general purpose timer register address"
	depends on DRIVER_TIMER_MEDIATEK
	default 0x10008048
	help
	  Address of the register to read the FREERUN-mode timer value.
```

## src/image/Kconfig
```kconfig
##
## Copyright 2016 Google Inc.  All rights reserved.
##
## This program is free software; you can redistribute it and/or modify
## it under the terms of the GNU General Public License as published by
## the Free Software Foundation; version 2 of the License.
##
## This program is distributed in the hope that it will be useful,
## but WITHOUT ANY WARRANTY; without even the implied warranty of
## MERCHANTABILITY or FITNESS FOR A PARTICULAR PURPOSE.  See the
## GNU General Public License for more details.
##
## You should have received a copy of the GNU General Public License
## along with this program; if not, write to the Free Software
## Foundation, Inc., 51 Franklin St, Fifth Floor, Boston, MA 02110-1301 USA


config FMAP_OFFSET
	hex "Offset of the FMAP in the firmware image"
	help
	  This is the offset of the FMAP in the ROM. The FMAP is not searched
	  for, so if the address isn't correct the system won't boot.

choice
	prompt "Image size"
        help
          The size of the image to build, if building a complete image.

config IMAGE_SIZE_256KB
	bool "256 KB"

config IMAGE_SIZE_512KB
	bool "512 KB"

config IMAGE_SIZE_1MB
	bool "1 MB"

config IMAGE_SIZE_2MB
	bool "2 MB"

config IMAGE_SIZE_4MB
	bool "4 MB"

config IMAGE_SIZE_8MB
	bool "8 MB"

config IMAGE_SIZE_16MB
	bool "16 MB"

endchoice

config IMAGE_SIZE_KB
	int
        default 256   if IMAGE_SIZE_256KB
        default 512   if IMAGE_SIZE_512KB
	default 1024  if IMAGE_SIZE_1MB
	default 2048  if IMAGE_SIZE_2MB
	default 4096  if IMAGE_SIZE_4MB
	default 8192  if IMAGE_SIZE_8MB
        default 16384 if IMAGE_SIZE_16MB

config BUILD_IMAGE_LAYOUT
	string "Layout to use for the image"
        default ""


choice
	prompt "Boot plan"
	help
	  Different ways of arranging depthcharge into modules. Which one to
          use depends on how depthcharge is started, and what it should do
          while running. Not all options will be supported on all boards.

config BOOTPLAN_CB_SPLIT_PAYLOAD
	bool "Coreboot payload (depthcharge selects firmware)"

config BOOTPLAN_CB_PAYLOAD
	bool "Coreboot payload (coreboot selects firmware)"

config BOOTPLAN_CB_IMAGE
	bool "Coreboot based image (coreboot selects firmware)"

endchoice

config BOOTPLAN_CB_IMAGE_MODEL
	string "Model name for this board"
	depends on BOOTPLAN_CB_IMAGE
```
