## board/bayleybay/defconfig
```kconfig
# Arch
CONFIG_ARCH_X86=y

# Board
CONFIG_BOARD="bayleybay"

# Image
CONFIG_BOOTPLAN_CB_PAYLOAD=y

CONFIG_FMAP_OFFSET=0x610000

# Vboot
CONFIG_OPROM_MATTERS=y
CONFIG_VIRTUAL_DEV_SWITCH=y
# TODO(shawnn): Remove mock TPM once we bring up the real TPM
CONFIG_MOCK_TPM=y

CONFIG_CROSSYSTEM_ACPI=y
CONFIG_NV_STORAGE_CMOS=y

# Kernel format
CONFIG_KERNEL_ZIMAGE=y

# Drivers
CONFIG_DRIVER_AHCI=y
CONFIG_DRIVER_FLASH_MEMMAPPED=y
CONFIG_DRIVER_INPUT_PS2=y
CONFIG_DRIVER_INPUT_USB=y
CONFIG_DRIVER_POWER_PCH=y
CONFIG_DRIVER_SOUND_HDA=y
CONFIG_DRIVER_STORAGE_MMC=y
CONFIG_DRIVER_STORAGE_SDHCI=y
CONFIG_DRIVER_STORAGE_SDHCI_PCI=y
CONFIG_DRIVER_TIMER_RDTSC=y
CONFIG_DRIVER_TPM_LPC=y

# libpayload
CONFIG_COREBOOT_VIDEO_CONSOLE=y

CONFIG_USB=y
# CONFIG_USB_UHCI is not set
# CONFIG_USB_OHCI is not set
# CONFIG_USB_EHCI is not set
CONFIG_USB_XHCI=y
```

## board/chell/defconfig
```kconfig
# Arch
CONFIG_ARCH_X86=y
CONFIG_ARCH_X86_IA32=y

# Board
CONFIG_BOARD="chell"
CONFIG_BOARD_DIR="glados"

# Image
CONFIG_BOOTPLAN_CB_PAYLOAD=y

CONFIG_FMAP_OFFSET=0xc10000

# Vboot
CONFIG_EC_SOFTWARE_SYNC=y
CONFIG_VIRTUAL_DEV_SWITCH=y

CONFIG_CROSSYSTEM_ACPI=y
CONFIG_NV_STORAGE_CMOS=y

# Kernel format
CONFIG_KERNEL_ZIMAGE=y

# Drivers
CONFIG_DRIVER_BUS_I2C_DESIGNWARE=y
CONFIG_DRIVER_BUS_I2C_DESIGNWARE_PCI=y
CONFIG_DRIVER_CONSOLE_UART=y
CONFIG_DRIVER_EC_CROS=y
CONFIG_DRIVER_EC_CROS_LPC=y
CONFIG_DRIVER_EC_CROS_PASSTHRU=y
CONFIG_DRIVER_FLASH_MEMMAPPED=y
CONFIG_DRIVER_GPIO_SKYLAKE=y
CONFIG_DRIVER_KEYBOARD_PS2=y
CONFIG_DRIVER_POWER_PCH=y
CONFIG_DRIVER_SOUND_GPIO_PDM=y
CONFIG_DRIVER_SOUND_ROUTE=y
CONFIG_DRIVER_SOUND_SSM4567=y
CONFIG_DRIVER_STORAGE_MMC=y
CONFIG_DRIVER_STORAGE_SDHCI=y
CONFIG_DRIVER_STORAGE_SDHCI_PCI=y
CONFIG_DRIVER_STORAGE_USB=y
CONFIG_DRIVER_TIMER_RDTSC=y
CONFIG_DRIVER_TPM_LPC=y
CONFIG_DRIVER_UART_8250=y
CONFIG_DRIVER_USB_HID=y

# libpayload
CONFIG_COREBOOT_VIDEO_CONSOLE=y

CONFIG_USB=y
# CONFIG_USB_UHCI is not set
# CONFIG_USB_OHCI is not set
# CONFIG_USB_EHCI is not set
CONFIG_USB_XHCI=y
```

## board/cosmos/defconfig
```kconfig
# Arch
CONFIG_ARCH_ARM=y
CONFIG_ARCH_ARM_V7=y

# Board
CONFIG_BOARD="cosmos"

# Image
CONFIG_BOOTPLAN_CB_SPLIT_PAYLOAD=y

CONFIG_BASE_ADDRESS=0x43000000
CONFIG_FMAP_OFFSET=0x00080000
CONFIG_HEAP_SIZE=0x01000000
CONFIG_KERNEL_START=0x2000000

# Vboot
CONFIG_VIRTUAL_DEV_SWITCH=y

CONFIG_CROSSYSTEM_FDT=y

# Kernel format
CONFIG_KERNEL_FIT=y
CONFIG_KERNEL_FIT_FDT_ADDR=0x6400000

# Drivers
CONFIG_DRIVER_FLASH_SPI=y
CONFIG_DRIVER_INPUT_USB=y
CONFIG_DRIVER_TPM_SLB9635_I2C=y

CONFIG_HEADLESS=y
CONFIG_NV_STORAGE_FLASH=y

# libpayload
CONFIG_CHROMEOS=y

CONFIG_SKIP_CONSOLE_INIT=y
CONFIG_BG4CD_SERIAL_CONSOLE=y
# CONFIG_VIDEO_CONSOLE is not set

CONFIG_TIMER_BG4CD=y
CONFIG_USB=y
# CONFIG_USB_OHCI is not set
# CONFIG_USB_EHCI is not set
# CONFIG_USB_XHCI is not set
# CONFIG_USB_HID is not set
# CONFIG_USB_HUB is not set
# CONFIG_USB_MSC is not set
# CONFIG_USB_PCI is not set
```

## board/cyan/defconfig
```kconfig
# Arch
CONFIG_ARCH_X86=y

# Board
CONFIG_BOARD="cyan"

# Image
CONFIG_BOOTPLAN_CB_SPLIT_PAYLOAD=y

CONFIG_FMAP_OFFSET=0x610000

# Vboot
CONFIG_EC_SOFTWARE_SYNC=y
CONFIG_VIRTUAL_DEV_SWITCH=y

CONFIG_CROSSYSTEM_ACPI=y
CONFIG_NV_STORAGE_CMOS=y

# Kernel format
CONFIG_KERNEL_ZIMAGE=y

# Drivers
CONFIG_DRIVER_EC_CROS=y
CONFIG_DRIVER_EC_CROS_LPC=y
CONFIG_DRIVER_FLASH_MEMMAPPED=y
CONFIG_DRIVER_INPUT_PS2=y
CONFIG_DRIVER_INPUT_USB=y
CONFIG_DRIVER_POWER_PCH=y
CONFIG_DRIVER_SDHCI=y
CONFIG_DRIVER_STORAGE_SDHCI_PCI=y
CONFIG_DRIVER_STORAGE_MMC=y
CONFIG_DRIVER_TPM_LPC=y
CONFIG_DRIVER_BUS_I2S_BRASWELL=y
CONFIG_DRIVER_BUS_I2S_BRASWELL_MAX98090=y
CONFIG_DRIVER_SOUND_MAX98090=y
CONFIG_DRIVER_BUS_I2C_DESIGNWARE=y
CONFIG_DRIVER_SOUND_I2S=y
CONFIG_DRIVER_SOUND_ROUTE=y
CONFIG_DRIVER_GPIO_BRASWELL=y

# libpayload
CONFIG_REMOTEGDB=y
CONFIG_CHROMEOS=y

CONFIG_SKIP_CONSOLE_INIT=y
# CONFIG_VGA_VIDEO_CONSOLE is not set
CONFIG_COREBOOT_VIDEO_CONSOLE=y

# CONFIG_SPEAKER is not set
# CONFIG_STORAGE is not set
CONFIG_USB=y
# CONFIG_USB_UHCI is not set
# CONFIG_USB_OHCI is not set
CONFIG_USB_EHCI=y
CONFIG_USB_XHCI=y
```

## board/jecht/defconfig
```kconfig
# Arch
CONFIG_ARCH_X86=y
CONFIG_ARCH_X86_IA32=y

# Board
CONFIG_BOARD="jecht"

# Image
CONFIG_BOOTPLAN_CB_PAYLOAD=y

CONFIG_FMAP_OFFSET=0x610000

# Vboot
CONFIG_OPROM_MATTERS=y
CONFIG_PHYSICAL_REC_SWITCH=y
CONFIG_VIRTUAL_DEV_SWITCH=y

CONFIG_CROSSYSTEM_ACPI=y
CONFIG_NV_STORAGE_CMOS=y

# Kernel format
CONFIG_KERNEL_ZIMAGE=y

# Drivers
CONFIG_DRIVER_AHCI=y
CONFIG_DRIVER_BLOCKDEV_USB=y
CONFIG_DRIVER_CONSOLE_UART=y
CONFIG_DRIVER_FLASH_MEMMAPPED=y
CONFIG_DRIVER_GPIO_LYNXPOINT_LP=y
CONFIG_DRIVER_KEYBOARD_PS2=y
CONFIG_DRIVER_LAYOUT_COREBOOT=y
CONFIG_DRIVER_POWER_PCH=y
CONFIG_DRIVER_SOUND_PCAT_BEEP=y
CONFIG_DRIVER_STORAGE_FLASH=y
CONFIG_DRIVER_TIMER_RDTSC=y
CONFIG_DRIVER_TPM_LPC=y
CONFIG_DRIVER_UART_8250=y
CONFIG_DRIVER_USB_HID=y

# libpayload
CONFIG_COREBOOT_VIDEO_CONSOLE=y

CONFIG_USB=y
# CONFIG_USB_UHCI is not set
# CONFIG_USB_OHCI is not set
# CONFIG_USB_EHCI is not set
CONFIG_USB_XHCI=y
```

## board/link/defconfig
```kconfig
# Arch
CONFIG_ARCH_X86=y

# Board
CONFIG_BOARD="link"

# Image
CONFIG_BOOTPLAN_CB_SPLIT_PAYLOAD=y

CONFIG_FMAP_OFFSET=0x610000

# Vboot
CONFIG_EC_SOFTWARE_SYNC=y
CONFIG_OPROM_MATTERS=y
CONFIG_VIRTUAL_DEV_SWITCH=y

CONFIG_CROSSYSTEM_ACPI=y
CONFIG_NV_STORAGE_CMOS=y

# Kernel format
CONFIG_KERNEL_ZIMAGE=y

# Drivers
CONFIG_DRIVER_AHCI=y
CONFIG_DRIVER_EC_CROS=y
CONFIG_DRIVER_EC_CROS_LPC=y
CONFIG_DRIVER_FLASH_MEMMAPPED=y
CONFIG_DRIVER_GPIO_PANTHERPOINT=y
CONFIG_DRIVER_KEYBOARD_PS2=y
CONFIG_DRIVER_KEYBOARD_USB=y
CONFIG_DRIVER_POWER_PCH=y
CONFIG_DRIVER_SOUND_HDA=y
CONFIG_DRIVER_STORAGE_USB=y
CONFIG_DRIVER_TIMER_RDTSC=y
CONFIG_DRIVER_TPM_LPC=y
CONFIG_DRIVER_UART_8250=y

# libpayload
CONFIG_COREBOOT_VIDEO_CONSOLE=y

CONFIG_USB=y
CONFIG_USB_UHCI=y
CONFIG_USB_OHCI=y
CONFIG_USB_EHCI=y
CONFIG_USB_XHCI=y
```

## board/qemu-x86/defconfig
```kconfig
# Arch
CONFIG_ARCH_X86=y

# Board
CONFIG_BOARD="qemu-x86"

# Image
CONFIG_BOOTPLAN_QEMU_X86=y

CONFIG_IMAGE_HWID="QEMU TEST"
CONFIG_IMAGE_SIZE_8MB=y

# Vboot
CONFIG_VIRTUAL_DEV_SWITCH=y

CONFIG_NV_STORAGE_CMOS=y

# Kernel format
CONFIG_KERNEL_ZIMAGE=y

# Drivers
CONFIG_DRIVER_KEYBOARD_PS2=y
CONFIG_DRIVER_TIMER_RDTSC=y
CONFIG_DRIVER_UART_8250=y

# libpayload
```

## board/samus/defconfig
```kconfig
# Arch
CONFIG_ARCH_X86=y

# Board
CONFIG_BOARD="samus"

# Image
CONFIG_BOOTPLAN_CB_IMAGE=y
CONFIG_BOOTPLAN_CB_IMAGE_MODEL="Google_Samus"
CONFIG_BUILD_IMAGE_LAYOUT="samus_cb"
CONFIG_IMAGE_SIZE_8MB=y

CONFIG_FMAP_OFFSET=0x610000

# Vboot
CONFIG_EC_SOFTWARE_SYNC=y
CONFIG_OPROM_MATTERS=y
CONFIG_VIRTUAL_DEV_SWITCH=y

CONFIG_CROSSYSTEM_ACPI=y
CONFIG_NV_STORAGE_CMOS=y

# Kernel format
CONFIG_KERNEL_ZIMAGE=y

# Drivers
CONFIG_DRIVER_AHCI=y
CONFIG_DRIVER_BUS_I2C_DESIGNWARE=y
CONFIG_DRIVER_BUS_I2S_BROADWELL=y
CONFIG_DRIVER_BUS_I2S_BROADWELL_ALC5677=y
CONFIG_DRIVER_EC_CROS=y
CONFIG_DRIVER_EC_CROS_LPC=y
CONFIG_DRIVER_EC_CROS_PASSTHRU=y
CONFIG_DRIVER_FLASH_MEMMAPPED=y
CONFIG_DRIVER_GPIO_LYNXPOINT_LP=y
CONFIG_DRIVER_INPUT_PS2=y
CONFIG_DRIVER_INPUT_USB=y
CONFIG_DRIVER_POWER_PCH=y
CONFIG_DRIVER_SOUND_I2S=y
CONFIG_DRIVER_SOUND_ROUTE=y
CONFIG_DRIVER_SOUND_RT5677=y
CONFIG_DRIVER_TIMER_RDTSC=y
CONFIG_DRIVER_TPM_LPC=y
CONFIG_DRIVER_VIDEO_INTEL_I915=y

# libpayload
CONFIG_COREBOOT_VIDEO_CONSOLE=y

CONFIG_USB=y
# CONFIG_USB_UHCI is not set
# CONFIG_USB_OHCI is not set
# CONFIG_USB_EHCI is not set
CONFIG_USB_XHCI=y
```

## board/smaug/defconfig
```kconfig
# Arch
CONFIG_ARCH_ARM=y
CONFIG_ARCH_ARM_V8=y

# Board
CONFIG_BOARD="smaug"

# Image
CONFIG_BOOTPLAN_CB_PAYLOAD=y

CONFIG_BASE_ADDRESS=0x88000000
CONFIG_FMAP_OFFSET=0x00400000
CONFIG_HEAP_SIZE=0x02000000
CONFIG_KERNEL_START=0x85000000
CONFIG_KERNEL_SIZE=0x02000000

# Vboot
CONFIG_EC_SOFTWARE_SYNC=y
CONFIG_VIRTUAL_DEV_SWITCH=y
CONFIG_CROSSYSTEM_FDT=y
CONFIG_NV_STORAGE_FLASH=y

# Kernel format
CONFIG_KERNEL_FIT=y
CONFIG_KERNEL_FIT_FDT_ADDR=0x9ff00000

# Drivers
CONFIG_DRIVER_BUS_I2C_TEGRA=y
CONFIG_DRIVER_BUS_I2S_TEGRA=y
CONFIG_DRIVER_BUS_SPI_TEGRA=y
CONFIG_DRIVER_DMA_TEGRA_APB=y
CONFIG_DRIVER_EC_CROS=y
CONFIG_DRIVER_EC_CROS_I2C=y
CONFIG_DRIVER_FLASH_SPI=y
CONFIG_DRIVER_GPIO_TEGRA=y
CONFIG_DRIVER_INPUT_USB=y
CONFIG_DRIVER_POWER_MAX77620=y
CONFIG_DRIVER_STORAGE_MMC=y
CONFIG_DRIVER_STORAGE_MMC_TEGRA=y
CONFIG_DRIVER_TPM_SLB9635_I2C=y
CONFIG_DRIVER_SOUND_I2S=y
CONFIG_DRIVER_SOUND_RT5677=y
CONFIG_DRIVER_SOUND_ROUTE=y
CONFIG_DRIVER_SOUND_TEGRA_AUDIO_HUB=y
CONFIG_DRIVER_VIDEO_TEGRA210=y

# libpayload
CONFIG_GPL=y
CONFIG_REMOTEGDB=y
CONFIG_CHROMEOS=y

CONFIG_SKIP_CONSOLE_INIT=y
CONFIG_8250_MMIO32_SERIAL_CONSOLE=y
CONFIG_COREBOOT_VIDEO_CONSOLE=y

# CONFIG_STORAGE is not set
CONFIG_TIMER_TEGRA_1US=y
CONFIG_USB=y
# CONFIG_USB_OHCI is not set
CONFIG_USB_EHCI=y
CONFIG_USB_XHCI=y
CONFIG_UDC=y
CONFIG_UDC_CI=y
```

## board/uefi/defconfig
```kconfig
# Arch
CONFIG_ARCH_X86=y
CONFIG_ARCH_X86_AMD64=y

CONFIG_EXTRA_CFLAGS="-fpie -fshort-wchar -mno-red-zone -DEFIAPI='__attribute__((ms_abi))'"

# Board
CONFIG_BOARD="uefi"

# Image
CONFIG_BOOTPLAN_UEFI=y

CONFIG_IMAGE_HWID="UEFI TEST"

# Vboot
CONFIG_MOCK_TPM=y
CONFIG_DISABLE_LEGACY_BOOT=y

# Kernel format
CONFIG_KERNEL_ZIMAGE=y

# Drivers
CONFIG_DRIVER_CONSOLE_UEFI=y
CONFIG_DRIVER_LAYOUT_UEFI=y
CONFIG_DRIVER_STORAGE_FWDB=y
CONFIG_DRIVER_TIMER_RDTSC=y

# libpayload
```

## board/veyron_rialto/defconfig
```kconfig
# Arch
CONFIG_ARCH_ARM=y
CONFIG_ARCH_ARM_V7=y

# Board
CONFIG_BOARD="veyron_rialto"

# Image
CONFIG_BOOTPLAN_CB_PAYLOAD=y

CONFIG_BASE_ADDRESS=0x23000000
CONFIG_FMAP_OFFSET=0x00100000
CONFIG_HEAP_SIZE=0x01000000
CONFIG_KERNEL_START=0x2000000

# Vboot
CONFIG_USB_BOOT_ON_DEV=y
CONFIG_VIRTUAL_DEV_SWITCH=y

CONFIG_CROSSYSTEM_FDT=y
CONFIG_HEADLESS=y
CONFIG_NV_STORAGE_FLASH=y

# Kernel format
CONFIG_KERNEL_FIT=y
CONFIG_KERNEL_FIT_FDT_ADDR=0x6400000

# Drivers
CONFIG_DRIVER_BUS_I2C_ROCKCHIP=y
CONFIG_DRIVER_BUS_I2S_ROCKCHIP=y
CONFIG_DRIVER_BUS_SPI_ROCKCHIP=y
CONFIG_DRIVER_FLASH_SPI=y
CONFIG_DRIVER_GPIO_ROCKCHIP=y
CONFIG_DRIVER_INPUT_USB=y
CONFIG_DRIVER_POWER_RK808=y
CONFIG_DRIVER_SERIAL_8250_MMIO32=y
CONFIG_DRIVER_STORAGE_MMC=y
CONFIG_DRIVER_STORAGE_MMC_ROCKCHIP=y
CONFIG_DRIVER_STORAGE_USB=y
CONFIG_DRIVER_TIMER_ROCKCHIP=y
CONFIG_DRIVER_TPM_SLB9635_I2C=y

# libpayload
# CONFIG_VIDEO_CONSOLE is not set

CONFIG_USB=y
# CONFIG_USB_OHCI is not set
CONFIG_USB_EHCI=y
# CONFIG_USB_XHCI is not set
CONFIG_USB_DWC2=y
```

## config/qemu-x86/defconfig
```kconfig
# Arch
CONFIG_ARCH_X86=y
CONFIG_ARCH_X86_IA32=y

# Board
CONFIG_BOARD="qemu-x86"

# Image
CONFIG_BOOTPLAN_QEMU_X86=y

CONFIG_IMAGE_HWID="QEMU TEST"
CONFIG_IMAGE_SIZE_8MB=y

# Vboot
CONFIG_VIRTUAL_DEV_SWITCH=y
CONFIG_MOCK_TPM=y

CONFIG_NV_STORAGE_CMOS=y

# Kernel format
CONFIG_KERNEL_ZIMAGE=y

# Drivers
CONFIG_DRIVER_CONSOLE_UART=y
CONFIG_DRIVER_KEYBOARD_PS2=y
CONFIG_DRIVER_LAYOUT_DCDIR=y
CONFIG_DRIVER_POWER_PCH=y
CONFIG_DRIVER_STORAGE_MEMORY=y
CONFIG_DRIVER_TIMER_RDTSC=y
CONFIG_DRIVER_UART_8250=y

# libpayload
CONFIG_CBMEM_CONSOLE=y
CONFIG_VIDEO_CONSOLE=y
```

## config/veyron_rialto/defconfig
```kconfig
# Arch
CONFIG_ARCH_ARM=y
CONFIG_ARCH_ARM_V7=y

# Board
CONFIG_BOARD="veyron_rialto"

# Image
CONFIG_BOOTPLAN_CB_PAYLOAD=y

CONFIG_BASE_ADDRESS=0x23000000
CONFIG_FMAP_OFFSET=0x00100000
CONFIG_HEAP_SIZE=0x01000000
CONFIG_KERNEL_START=0x2000000

# Vboot
CONFIG_USB_BOOT_ON_DEV=y
CONFIG_VIRTUAL_DEV_SWITCH=y

CONFIG_CROSSYSTEM_FDT=y
CONFIG_HEADLESS=y
CONFIG_NV_STORAGE_FLASH=y

# Kernel format
CONFIG_KERNEL_FIT=y
CONFIG_KERNEL_FIT_FDT_ADDR=0x6400000

# Drivers
CONFIG_DRIVER_BLOCKDEV_MMC=y
CONFIG_DRIVER_BLOCKDEV_MMC_ROCKCHIP=y
CONFIG_DRIVER_BLOCKDEV_USB=y
CONFIG_DRIVER_BUS_I2C_ROCKCHIP=y
CONFIG_DRIVER_BUS_I2S_ROCKCHIP=y
CONFIG_DRIVER_BUS_SPI_ROCKCHIP=y
CONFIG_DRIVER_CONSOLE_UART=y
CONFIG_DRIVER_FLASH_SPI=y
CONFIG_DRIVER_GPIO_ROCKCHIP=y
CONFIG_DRIVER_LAYOUT_COREBOOT=y
CONFIG_DRIVER_POWER_RK808=y
CONFIG_DRIVER_STORAGE_FLASH=y
CONFIG_DRIVER_TIMER_ROCKCHIP=y
CONFIG_DRIVER_TPM_SLB9635_I2C=y
CONFIG_DRIVER_UART_8250=y

# libpayload
# CONFIG_VIDEO_CONSOLE is not set

CONFIG_USB=y
CONFIG_USB_EHCI=y
CONFIG_USB_UHCI=y

CONFIG_USB_DWC2=y
```

## src/arch/arm/Kconfig
```kconfig
##
## Copyright 2012 Google Inc.
##
## Redistribution and use in source and binary forms, with or without
## modification, are permitted provided that the following conditions
## are met:
## 1. Redistributions of source code must retain the above copyright
##    notice, this list of conditions and the following disclaimer.
## 2. Redistributions in binary form must reproduce the above copyright
##    notice, this list of conditions and the following disclaimer in the
##    documentation and/or other materials provided with the distribution.
## 3. The name of the author may not be used to endorse or promote products
##    derived from this software without specific prior written permission.
##
## THIS SOFTWARE IS PROVIDED BY THE AUTHOR AND CONTRIBUTORS ``AS IS'' AND
## ANY EXPRESS OR IMPLIED WARRANTIES, INCLUDING, BUT NOT LIMITED TO, THE
## IMPLIED WARRANTIES OF MERCHANTABILITY AND FITNESS FOR A PARTICULAR PURPOSE
## ARE DISCLAIMED.  IN NO EVENT SHALL THE AUTHOR OR CONTRIBUTORS BE LIABLE
## FOR ANY DIRECT, INDIRECT, INCIDENTAL, SPECIAL, EXEMPLARY, OR CONSEQUENTIAL
## DAMAGES (INCLUDING, BUT NOT LIMITED TO, PROCUREMENT OF SUBSTITUTE GOODS
## OR SERVICES; LOSS OF USE, DATA, OR PROFITS; OR BUSINESS INTERRUPTION)
## HOWEVER CAUSED AND ON ANY THEORY OF LIABILITY, WHETHER IN CONTRACT, STRICT
## LIABILITY, OR TORT (INCLUDING NEGLIGENCE OR OTHERWISE) ARISING IN ANY WAY
## OUT OF THE USE OF THIS SOFTWARE, EVEN IF ADVISED OF THE POSSIBILITY OF
## SUCH DAMAGE.
##

choice
	prompt "ARM Version"
	depends on ARCH_ARM
	default ARCH_ARM_V7
	help
	  Version for ARM Arch

config ARCH_ARM_V7
	bool "ARMv7"

config ARCH_ARM_V8
	bool "ARMv8"

endchoice

if ARCH_ARM_V8

config DMA_LIM_EXCL
	hex "DMA address limit(exclusive) in MiB units"
	default 0x1000

endif
```
